## components/audio/Kconfig
```kconfig
menu "Speaker Output"

    config KERN_AUDIO
        bool "Enable speaker output (ES8311 codec)"
        default y
        help
            Compile support for driving the ES8311 audio codec and the
            amplifier behind the board's speaker header. It exists so the
            screen reader has somewhere to speak; nothing else in Kern makes
            sound.

            Building it in does not turn it on: audio_init() is only reached
            when the screen reader is enabled at runtime, which is off by
            default, and the amplifier is powered only while something is
            actually playing.

            The Waveshare boards carry the codec but ship the speaker header
            empty. Without a speaker wired to it this is inert.

    config KERN_AUDIO_I2C_ADDR
        hex "ES8311 I2C address"
        default 0x18
        depends on KERN_AUDIO
        help
            7-bit I2C address of the codec, on the same bus the display and
            camera already use. 0x18 is the ES8311 default and is what every
            Waveshare ESP32-P4 board wires.

    config KERN_AUDIO_MCLK_GPIO
        int "I2S MCLK GPIO"
        default 13
        depends on KERN_AUDIO
        help
            Master clock to the codec, run at 256x the sample rate. The
            defaults for this and the three pins below are shared by every
            Waveshare ESP32-P4-WIFI6-Touch-LCD board.

    config KERN_AUDIO_BCLK_GPIO
        int "I2S BCLK GPIO"
        default 12
        depends on KERN_AUDIO

    config KERN_AUDIO_LRCK_GPIO
        int "I2S LRCK GPIO"
        default 10
        depends on KERN_AUDIO

    config KERN_AUDIO_DOUT_GPIO
        int "I2S data-out GPIO"
        default 9
        depends on KERN_AUDIO

    config KERN_AUDIO_PA_GPIO
        int "Amplifier enable GPIO"
        default 53
        depends on KERN_AUDIO
        help
            Drives the NS4150B enable line, active high. Held low except
            while audio is playing, which keeps the speaker quiet and the
            amplifier unpowered the rest of the time.

    config KERN_AUDIO_VOLUME
        int "Playback volume (0-100)"
        default 70
        range 0 100
        depends on KERN_AUDIO
        help
            DAC volume the codec is programmed with at bring-up. A signer
            that announces itself is a signer that can be overheard, so the
            default sits below the amplifier's full output.

endmenu
```

## components/nfc/Kconfig
```kconfig
menu "NFC Card Storage"

    config KERN_NFC
        bool "Enable NFC card storage (M5Stack RFID Unit 2 or PN532)"
        default y
        help
            Compile support for keeping KEF-encrypted mnemonics on NFC cards,
            read and written through an external reader on the board's I2C
            bus: an M5Stack RFID Unit 2 (WS1850S) or a PN532 module. Whichever
            is plugged in is found at runtime.

            Building it in does not turn it on: the feature stays inert until
            it is also enabled at runtime under Settings -> NFC, which is off
            by default. The RF field is energized only while the card page is
            open.

    config KERN_NFC_WS1850S
        bool "Support the M5Stack RFID Unit 2 (WS1850S)"
        default y
        depends on KERN_NFC

    config KERN_NFC_I2C_ADDR
        hex "WS1850S I2C address"
        default 0x28
        depends on KERN_NFC_WS1850S
        help
            7-bit I2C address of the reader. 0x28 is the M5Stack RFID Unit 2
            factory default.

    config KERN_NFC_PN532
        bool "Support PN532 modules (Elechouse V3 and clones)"
        default y
        depends on KERN_NFC
        help
            The red "PN532 NFC RFID V3" board and its clones. Set the module's
            mode switch to I2C and power it from 3.3 V: its pull-ups tie SDA
            and SCL to its own supply, and the bus is shared with the touch
            controller.

    config KERN_NFC_PN532_I2C_ADDR
        hex "PN532 I2C address"
        default 0x24
        depends on KERN_NFC_PN532
        help
            7-bit I2C address of the PN532. Fixed at 0x24 by the chip.

    config KERN_NFC_I2C_TIMEOUT_MS
        int "I2C transaction timeout (ms)"
        default 100
        depends on KERN_NFC
        help
            Per-transfer timeout for reader access. Bounds every blocking call
            so an absent or wedged module cannot stall the UI.

endmenu
```
